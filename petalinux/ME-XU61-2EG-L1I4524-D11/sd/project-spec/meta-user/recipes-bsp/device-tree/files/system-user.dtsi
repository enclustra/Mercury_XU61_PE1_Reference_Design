/include/ "system-conf.dtsi"
/ {
	model = "Enclustra ME-XU61-2EG-L1I4524-D11 SOM";
};
#include "zynqmp_enclustra_common.dtsi"
#include "zynqmp_enclustra_mercury_xu61.dtsi"
#include "zynqmp_enclustra_mercury_pe1.dtsi"
