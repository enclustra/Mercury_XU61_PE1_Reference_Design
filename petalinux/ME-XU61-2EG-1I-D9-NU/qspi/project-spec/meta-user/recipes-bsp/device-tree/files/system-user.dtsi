/include/ "system-conf.dtsi"
/ {
	model = "Enclustra ME-XU61-2EG-1I-D9-NU SOM";
};
#include "zynqmp_enclustra_common.dtsi"
#include "zynqmp_enclustra_mercury_xu61.dtsi"
#include "zynqmp_enclustra_mercury_pe1.dtsi"
